## configs/soteria_defconfig
```kconfig
BR2_aarch64=y
BR2_TOOLCHAIN_EXTERNAL=y
BR2_TARGET_GENERIC_HOSTNAME="soteria"
BR2_TARGET_GENERIC_ISSUE="Welcome to Soteria"
BR2_ROOTFS_DEVICE_CREATION_DYNAMIC_MDEV=y
BR2_TARGET_GENERIC_ROOT_PASSWD="root"
BR2_TARGET_GENERIC_GETTY_PORT="ttyPS1"
BR2_ROOTFS_OVERLAY="board/alion/soteria/rootfs_overlay"
BR2_LINUX_KERNEL=y
BR2_LINUX_KERNEL_CUSTOM_GIT=y
BR2_LINUX_KERNEL_CUSTOM_REPO_URL="https://github.com/bfrantz/linux-xlnx.git"
BR2_LINUX_KERNEL_CUSTOM_REPO_VERSION="master"
BR2_LINUX_KERNEL_DEFCONFIG="xilinx_zynqmp"
BR2_LINUX_KERNEL_DTS_SUPPORT=y
BR2_LINUX_KERNEL_INTREE_DTS_NAME="xilinx/zynqmp-soteria"
BR2_PACKAGE_UBOOT_TOOLS=y
BR2_PACKAGE_UBOOT_TOOLS_MKIMAGE=y
BR2_PACKAGE_LIBUSB=y
BR2_PACKAGE_LIBUSB_COMPAT=y
BR2_PACKAGE_NTP=y
BR2_PACKAGE_NTP_NTP_KEYGEN=y
BR2_PACKAGE_NTP_NTPDATE=y
BR2_PACKAGE_THTTPD=y
BR2_PACKAGE_XINETD=y
BR2_TARGET_ROOTFS_CPIO_GZIP=y
BR2_TARGET_ROOTFS_INITRAMFS=y
# BR2_TARGET_ROOTFS_TAR is not set
BR2_TARGET_ATFIRMWARE=y
BR2_TARGET_ATFIRMWARE_CUSTOM_GIT=y
BR2_TARGET_ATFIRMWARE_CUSTOM_GIT_REPO_URL="https://github.com/Xilinx/arm-trusted-firmware.git"
BR2_TARGET_ATFIRMWARE_CUSTOM_GIT_VERSION="xilinx-v2016.2"
BR2_TARGET_ATFIRMWARE_PLATFORM="zynqmp"
BR2_TARGET_ATFIRMWARE_ADDITIONAL_VARIABLES="RESET_TO_BL31=1"
BR2_TARGET_UBOOT=y
BR2_TARGET_UBOOT_BUILD_SYSTEM_KCONFIG=y
BR2_TARGET_UBOOT_CUSTOM_GIT=y
BR2_TARGET_UBOOT_CUSTOM_REPO_URL="https://github.com/bfrantz/u-boot-xlnx.git"
BR2_TARGET_UBOOT_CUSTOM_REPO_VERSION="master"
BR2_TARGET_UBOOT_BOARD_DEFCONFIG="zynqmp_soteria"
BR2_TARGET_UBOOT_NEEDS_DTC=y
BR2_TARGET_UBOOT_FORMAT_CUSTOM=y
BR2_TARGET_UBOOT_FORMAT_CUSTOM_NAME="u-boot.elf"
BR2_PACKAGE_HOST_UBOOT_TOOLS=y
```
